#define IR_SW1 2                          // กำหนด ขา sensor ตัวที่ 1 ขาขึ้น บวกเลข
#define IR_SW2 3                          // กำหนด ขา sensor ตัวที่ 2 ขาลง ลบเลข
int ledfull = 13;
int ledempty = 12;

int counter1 = 0;                         // กำหนดตัวแปลสำหรับเอาไว้รอนับจำนวนรถเข้า - ออก
int counter2 = 6;                        // กำหนดตัวแปลสำหรับเอาไว้รอนับจำนวนที่ว่าง


unsigned long time_ms_buffer;             // กำหนดเวลาสำหรับการหน่วงเพื่อ + และ - ค่าใน ฟังชั่น

void plus(void) {                           // ฟังชั่น บวกเลข
  if ((millis() - time_ms_buffer) > 1000) { // รันเวลา เอามา - กับเวลาที่กำหนด ถ้าน้อยกว่า 1000 หรือ การหน่วงประมาณ 3 วินาที เมื่อเข้าเงื่อนไงนี้ให้ทำบรรทัดช้าล่างต่อ

    counter1++;                              //  counter1 ++ คือการ + 1 เพื่อบอกว่า คนเข้ามา 1
    counter2--;                              //  counter2 -- คือการ - 1 เพื่อบอกว่า ที่ว่างลดลง 1 เมื่อเข้ามา 1
    if (counter1 >= 6) {                    // เลข 10 เอาไว้ set จำนวนที่นั่ง ตอนปกติ คือ 0 ที่นั่ง เมื่อขึ้น จะ +1 จนครบ 10 จะเห็นว่า เมื่อไหร่ที่ค่า  counter มากว่า 10 หมายถึงเกิน 10 ให้ทำเงื่อนไขข้างล่างต่อ
      counter1 = 6;                         // คือการ set ค่าให้ counter นั่น เท่ากับ 10 ไปเลย
    }
    if (counter2 < 0) {                      // เอาไว้ set จำนวนที่ ตอนปกติ คือ 3 ที่ เมื่อลง จะ -1 ถ้าถึง 0 ที่นั่งให้เท่ากับ 0
      counter2 = 0;
    }
  }
  time_ms_buffer = millis();                // เวลาที่กำหนด เท่ากับเวลาของการรัน
}

void wanting(void) {                        // ฟังชั่น ลบเลข
  if ((millis() - time_ms_buffer) > 1000) { // รันเวลา เอามา - กับเวลาที่กำหนด ถ้าน้อยกว่า 1000 หรือ การหน่วงประมาณ 3 วินาที เมื่อเข้าเงื่อนไงนี้ให้ทำบรรทัดช้าล่างต่อ

    counter1--;                              //  counter1 -- คือการ - 1 เพื่อบอกว่า ที่ว่างเพิ่มขึ้น 1 เมื่อตนออก 1
    counter2++;                              //  counter2 ++ คือการ + 1 เพื่อบอกว่า รถไปออก 1
    if (counter1 < 0) {                      // เอาไว้ set จำนวนที่ ตอนปกติ คือ 3 ที่ เมื่อลง จะ -1 ถ้าถึง 0 ที่นั่งให้เท่ากับ 0
      counter1 = 0;
    }
    if (counter2 >= 6) {                    // เลข 10 เอาไว้ set จำนวนที่นั่ง ตอนปกติ คือ 0 ที่นั่ง เมื่อขึ้น จะ +1 จนครบ 10 จะเห็นว่า เมื่อไหร่ที่ค่า  counter มากว่า 10 หมายถึงเกิน 10 ให้ทำเงื่อนไขข้างล่างต่อ
      counter2 = 6;                         // คือการ set ค่าให้ counter นั่น เท่ากับ 10 ไปเลย
    }
  }
  time_ms_buffer = millis();                 // เวลาที่กำหนด เท่ากับเวลาของการรัน
}

void setup()                                // ฟั่งชัน setup มีไว้สำหรับการกำหนดค่าเริ่มต้นต่างๆก่อนเริ่มการทำงาน
{
  Serial.begin(115200);                     // กำหนดการส่งข้อมูลผ่านพอต ที่มีขนาด 115200
  pinMode(ledempty, OUTPUT);
  pinMode(ledfull, OUTPUT);
  pinMode(IR_SW1, INPUT);                   // กำหนดขาการเขื่อมต่อ ของ sensor ตัวที่ 1 เป็นแบบ input
  pinMode(IR_SW2, INPUT);                   // กำหนดขาการเขื่อมต่อ ของ sensor ตัวที่ 2 เป็นแบบ input
  attachInterrupt(digitalPinToInterrupt(IR_SW1), plus, FALLING);     // ขาขึ้น เมื่อมีสัญญานจากเซ็นเซอร์เข้ามา จำทำการทำงานทันที และเรียกฟังชั่น บวกเลขและเก็บค่าไว้ใน ตัวแปล counter
  attachInterrupt(digitalPinToInterrupt(IR_SW2), wanting, FALLING);  // ขาลง เมื่อมีสัญญานจากเซ็นเซอร์เข้ามา จำทำการทำงานทันที และเรียกฟังชั่น ลบเลขและเก็บค่าไว้ใน ตัวแปล counter
}
void loop()                                        // ฟังชั่น loop จะวนการทำงานไปเรื่อยๆ เหมื่อนการรันการทำงานตลอดเวลา อะไรที่อยู่ในนี้จะทำงานตลอดเวลา
{

  Serial.println("COUNT>>: " + String(counter1));  // เริ่มปริ้นค่าใน counter
  Serial.println("EMPTY>>: " + String(counter2)); // เริ่มปริ้นค่าใน counter

  if ((counter1 == 6) && (counter2 == 0)) {       // รถจะเต็มได้ก็ต่อ เมื่อ เข้า 6 คัน และว่าง แค่ 0 ที่ ที่เหลือ คือเคสไม่เต็มเลยให้ มันเป็น else คือติดหมด
    digitalWrite(ledempty, LOW);                  // ไฟเขียวดับ
    digitalWrite(ledfull, HIGH);                  // เมื่อรภเต็มไฟแดงติด
  } else {
    digitalWrite(ledempty, HIGH);                 //  เมื่อรภว่างไฟเขียวติด
    digitalWrite(ledfull, LOW);                   // ไฟแดงดับ
  }

}
